/*
 * Copyright (c) 2024 The ZMK Contributors
 *
 * SPDX-License-Identifier: MIT
 */

#include <dt-bindings/zmk/matrix_transform.h>

/ {
    encoder_1: encoder_1 {
        compatible = "alps,ec11";
        a-gpios = <&blackpill 40 (GPIO_ACTIVE_HIGH  | GPIO_PULL_UP)>;
        b-gpios = <&blackpill 41 (GPIO_ACTIVE_HIGH  | GPIO_PULL_UP)>;
        steps = <80>;
        status = "disabled";
    };
};